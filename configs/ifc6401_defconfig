## configs/ifc6401_defconfig
```kconfig
BR2_arm=y
BR2_cortex_a9=y
BR2_ARM_ENABLE_NEON=y
BR2_ARM_ENABLE_VFP=y
BR2_ARM_FPU_VFPV3=y
BR2_TOOLCHAIN_EXTERNAL=y
BR2_TARGET_GENERIC_ROOT_PASSWD="toor"
BR2_ROOTFS_OVERLAY="board/ifc6401/overlay"
BR2_ROOTFS_POST_IMAGE_SCRIPT="board/ifc6401/kernel-dtb-image.sh board/ifc6401/kernel-abootimg.sh"
BR2_LINUX_KERNEL=y
BR2_LINUX_KERNEL_CUSTOM_GIT=y
BR2_LINUX_KERNEL_CUSTOM_REPO_URL="https://git.linaro.org/people/john.stultz/flo.git"
BR2_LINUX_KERNEL_CUSTOM_REPO_VERSION="93520092b9a442f09f943b57bd3f4648409e4a0a"
BR2_LINUX_KERNEL_USE_CUSTOM_CONFIG=y
BR2_LINUX_KERNEL_CUSTOM_CONFIG_FILE="board/ifc6401/linux_kernel.config"
BR2_LINUX_KERNEL_DTS_SUPPORT=y
BR2_LINUX_KERNEL_USE_CUSTOM_DTS=y
BR2_LINUX_KERNEL_CUSTOM_DTS_PATH="board/ifc6401/linux.dts"
BR2_PACKAGE_FBV=y
# BR2_PACKAGE_FBV_PNG is not set
# BR2_PACKAGE_FBV_JPEG is not set
# BR2_PACKAGE_FBV_GIF is not set
BR2_PACKAGE_LUAJIT=y
BR2_PACKAGE_LUA_PERIPHERY=y
BR2_TARGET_ROOTFS_CPIO=y
BR2_TARGET_ROOTFS_CPIO_XZ=y
```
